## collaborators/esp32s3_realtime_camera/sdkconfig.defaults
```kconfig
# ========== 芯片配置 ==========
CONFIG_IDF_TARGET="esp32s3"

# ========== PSRAM 配置 (ESP32-S3-EYE 需要) ==========
CONFIG_ESP32S3_SPIRAM_SUPPORT=y
CONFIG_SPIRAM=y
CONFIG_SPIRAM_MODE_OCT=y
CONFIG_SPIRAM_SPEED_80M=y
CONFIG_SPIRAM_BOOT_INIT=y
CONFIG_SPIRAM_USE_MALLOC=y
CONFIG_SPIRAM_MALLOC_ALWAYSINTERNAL=4096

# ========== Flash 配置 ==========
CONFIG_ESPTOOLPY_FLASHSIZE_8MB=y
CONFIG_ESPTOOLPY_FLASHSIZE_16MB=y

# ========== 分区表 ==========
CONFIG_PARTITION_TABLE_CUSTOM=y

# ========== WiFi 配置 ==========
CONFIG_ESP_WIFI_SOFTAP_SUPPORT=y
CONFIG_ESP_WIFI_NVS_ENABLED=y

# ========== HTTP 服务器 ==========
CONFIG_HTTPD_MAX_REQ_HDR_LEN=1024
CONFIG_HTTPD_MAX_URI_LEN=512

# ========== FreeRTOS ==========
CONFIG_FREERTOS_HZ=1000
CONFIG_FREERTOS_TIMER_TASK_STACK_DEPTH=4096

# ========== 日志级别 ==========
CONFIG_LOG_DEFAULT_LEVEL_INFO=y

# ========== 任务看门狗 ==========
CONFIG_ESP_TASK_WDT_TIMEOUT_S=30

# ========== LWIP ==========
CONFIG_LWIP_MAX_SOCKETS=16

# ========== 系统事件循环 ==========
CONFIG_ESP_SYSTEM_EVENT_TASK_STACK_SIZE=4096
```

## collaborators/项目猫-MVP/esp32_camera/sdkconfig.defaults
```kconfig
# 项目猫 - ESP32-S3-EYE 摄像头配置
# SDK 配置文件

# ==================== 摄像头配置 ====================
CONFIG_ESP32S3_DEFAULT_CPU_FREQ_240=y
CONFIG_ESP32S3_DATA_CACHE_64KB=y
CONFIG_ESP32S3_INSTRUCTION_CACHE_32KB=y

# 摄像头驱动支持
CONFIG_ESP_CAMERA_SUPPORT=y
CONFIG_ESP_CAMERA_SENSOR_OV2640=y
CONFIG_CAMERA_TASK_STACK_SIZE=4096
CONFIG_CAMERA_XCLK_FREQ_MHZ=20

# ==================== WiFi 配置 ====================
CONFIG_ESP_WIFI_SOFTAP_SUPPORT=n
CONFIG_ESP_WIFI_STA_DISCONNECTED_PM_ENABLE=y
CONFIG_ESP_WIFI_SLP_IRON_OPT=y

# ==================== HTTP 配置 ====================
CONFIG_ESP_HTTP_CLIENT_ENABLE_HTTPS=n
CONFIG_ESP_HTTP_CLIENT_ENABLE_BASIC_AUTH=y

# ==================== NVS 配置 ====================
CONFIG_NVS_FLASH_COMPRESSION=y

# ==================== LwIP 配置 ====================
CONFIG_LWIP_SO_REUSE=y
CONFIG_LWIP_SO_RCVBUF=y
CONFIG_LWIP_NETBUF_RECVINFO=y

# ==================== SNTP 配置 ====================
CONFIG_SNTP_MAX_SERVERS=1
CONFIG_SNTP_SERVER_DEFAULT_ADDRESS="pool.ntp.org"
CONFIG_SNTP_UPDATE_METHOD_SMOOTH=y

# ==================== 日志配置 ====================
CONFIG_LOG_DEFAULT_LEVEL_INFO=y
CONFIG_LOG_DEFAULT_LEVEL=3

# ==================== 分区表配置 ====================
CONFIG_PARTITION_TABLE_SINGLE_APP=y
CONFIG_ESP32S3_DATA_CACHE_LINE_64B=y

# ==================== 电源管理 ====================
CONFIG_PM_ENABLE=n
CONFIG_FREERTOS_HZ=1000

# ==================== SPI 配置 ====================
CONFIG_SPI_MASTER_ISR_IN_IRAM=y
CONFIG_SPI_SLAVE_ISR_IN_IRAM=y
```
